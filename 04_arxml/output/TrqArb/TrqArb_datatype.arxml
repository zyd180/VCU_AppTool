AUTOSAR XML (schema 00047)
standard types defined: Float, float32, sint32
package /DataTypes
  impl type En_DrvMode: category=VALUE, base-type=sint32, compu {0=ECO, 1=NORMAL, 2=SPORT}  # En_DrvMode from dd Enum sheet
package /DataTypes/Constants
  constant specification Cal_TrqMax: value-spec=Cal_TrqMax:1500
package /DataTypes/SwAddrMethods
  sw addr method CODE: section-type=CODE
  sw addr method CONST: section-type=CONST
  sw addr method VAR: section-type=VAR
package /DataTypes/Units
  unit NoUnit: factor-si-to-unit=1, offset-si-to-unit=0
