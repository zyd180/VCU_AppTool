AUTOSAR XML (schema 00047)
package /Components/SwcImplementations
  swc implementation TrqArb_Impl: programming-language=C, sw-version=1.36.1, used-code-generator=Embedded Coder 7.10 (R2023a) 19-Nov-2022, vendor-id=0, behavior=TrqArb_IB
    code-descriptors:
      code Code
        artifact-descriptors:
          short-label=TrqArb_c, category=SWSRC
          short-label=TrqArb_h, category=SWHDR
          short-label=TrqArb_private_h, category=SWHDR
          short-label=TrqArb_types_h, category=SWHDR
          short-label=rtwtypes_h, category=SWHDR
    resource consumption RsrcCons_TrqArb
