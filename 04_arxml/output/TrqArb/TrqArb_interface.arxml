AUTOSAR XML (schema 00047)
package /Interfaces
  sender receiver interface If_VehSpd
    data In_VehSpd: category=VALUE, sw-calibration-access=READ-ONLY, type=Float
  sender receiver interface If_DrvMode
    data In_DrvMode: category=VALUE, sw-calibration-access=READ-ONLY, type=En_DrvMode
  sender receiver interface If_DrvTrqReq
    data Out_DrvTrqReq: category=VALUE, sw-calibration-access=READ-ONLY, type=Float
