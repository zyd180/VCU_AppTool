AUTOSAR XML (schema 00047)
package /Components/SwcImplementations
  swc implementation BattIf_Impl: programming-language=C, sw-version=1.12.1, used-code-generator=Embedded Coder 7.10 (R2023a) 19-Nov-2022, vendor-id=0, behavior=BattIf_IB
    code-descriptors:
      code Code
        artifact-descriptors:
          short-label=BattIf_c, category=SWSRC
          short-label=BattIf_h, category=SWHDR
          short-label=BattIf_private_h, category=SWHDR
          short-label=BattIf_types_h, category=SWHDR
          short-label=rtwtypes_h, category=SWHDR
    resource consumption RsrcCons_BattIf
