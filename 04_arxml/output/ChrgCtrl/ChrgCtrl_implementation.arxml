AUTOSAR XML (schema 00047)
package /Components/SwcImplementations
  swc implementation ChrgCtrl_Impl: programming-language=C, sw-version=1.7.1, used-code-generator=Embedded Coder 7.10 (R2023a) 19-Nov-2022, vendor-id=0, behavior=ChrgCtrl_IB
    code-descriptors:
      code Code
        artifact-descriptors:
          short-label=ChrgCtrl_c, category=SWSRC
          short-label=ChrgCtrl_h, category=SWHDR
          short-label=ChrgCtrl_private_h, category=SWHDR
          short-label=ChrgCtrl_types_h, category=SWHDR
          short-label=rtwtypes_h, category=SWHDR
    resource consumption RsrcCons_ChrgCtrl
