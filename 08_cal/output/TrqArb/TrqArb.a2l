/******************************************************************************
* ASAP2 file: TrqArb.a2l
* Code generation for model "TrqArb".
* Model version : 1.32
* Simulink Coder version : 9.9 (R2023a) 19-Nov-2022
* C source code generated on : Sun Sep 06 01:02:13 2026
* Target selection: autosar.tlc
* Embedded hardware selection: Intel->x86-64 (Windows64)
* Code generation objectives: Unspecified
* Validation result: Not run
* (add additional file header information here)
******************************************************************************/ ASAP2_VERSION 1 71
/* Version 1.71 */
/begin PROJECT ProjectName "Project Comment Goes Here"
/begin HEADER "Header Comments go here" /end HEADER
/begin MODULE ModuleName "Module Comment Goes Here"
/begin MOD_PAR "MOD PAR Comment Goes Here" /end MOD_PAR
/begin MOD_COMMON "Mod Common Comment Here" BYTE_ORDER MSB_LAST ALIGNMENT_BYTE 1 ALIGNMENT_WORD 2 ALIGNMENT_LONG 4 ALIGNMENT_FLOAT32_IEEE 4 ALIGNMENT_FLOAT64_IEEE 8 ALIGNMENT_INT64 8 /end MOD_COMMON
/begin CHARACTERISTIC Cal_TrqMax /* Long Identifier */ "" /* Type */ VALUE /* ECU Address */ 0x0000 /* @ECU_Address@Cal_TrqMax@ */ /* Record Layout */ Record_FLOAT32_IEEE /* Maximum Difference */ 0 /* Conversion Method */ TrqArb_CM_single /* Lower Limit */ 0.000000 /* Upper Limit */ 2000.000000 /end CHARACTERISTIC
/begin MEASUREMENT In_DrvMode "" SLONG TrqArb_CM_En_DrvMode 0 0 0 2 ECU_ADDRESS 0x0000 /* @ECU_Address@In_DrvMode@ */ /end MEASUREMENT
/begin MEASUREMENT In_VehSpd "" FLOAT32_IEEE TrqArb_CM_single 0 0 -3.4E+38 3.4E+38 ECU_ADDRESS 0x0000 /* @ECU_Address@In_VehSpd@ */ /end MEASUREMENT
/begin MEASUREMENT Meas_TrqOut "" FLOAT32_IEEE TrqArb_CM_single 0 0 -3.4E+38 3.4E+38 ECU_ADDRESS 0x0000 /* @ECU_Address@Meas_TrqOut@ */ /end MEASUREMENT
/begin MEASUREMENT Out_DrvTrqReq "" FLOAT32_IEEE TrqArb_CM_single 0 0 -3.4E+38 3.4E+38 ECU_ADDRESS 0x0000 /* @ECU_Address@Out_DrvTrqReq@ */ /end MEASUREMENT
/begin MEASUREMENT TrqArb_Irv_TrqLim "" FLOAT32_IEEE TrqArb_CM_single 0 0 -3.4E+38 3.4E+38 ECU_ADDRESS 0x0000 /* @ECU_Address@TrqArb_Irv_TrqLim@ */ /end MEASUREMENT
/begin COMPU_METHOD /* Name of CompuMethod */ TrqArb_CM_En_DrvMode "Enumerated data type: En_DrvMode" TAB_VERB /* Format */ "%0.6" /* Units */ "" /* Conversion Table */ COMPU_TAB_REF VTAB_FOR_TrqArb_CM_En_DrvMode /end COMPU_METHOD
/begin COMPU_VTAB /* Name of Table */ VTAB_FOR_TrqArb_CM_En_DrvMode "Enumerated data type: En_DrvMode" TAB_VERB /* Number of Elements */ 3 0 "ECO" 1 "NORMAL" 2 "SPORT" /end COMPU_VTAB
/begin COMPU_METHOD /* Name of CompuMethod */ TrqArb_CM_single "Q = V" IDENTICAL /* Format */ "%8.6" /* Units */ "" /end COMPU_METHOD
/begin RECORD_LAYOUT Record_FLOAT32_IEEE FNC_VALUES 1 FLOAT32_IEEE COLUMN_DIR DIRECT /end RECORD_LAYOUT
/begin RECORD_LAYOUT Record_SLONG FNC_VALUES 1 SLONG COLUMN_DIR DIRECT /end RECORD_LAYOUT
/begin GROUP TrqArb "TrqArb" /* Root */ ROOT /begin REF_CHARACTERISTIC Cal_TrqMax /end REF_CHARACTERISTIC /begin REF_MEASUREMENT In_VehSpd Meas_TrqOut Out_DrvTrqReq TrqArb_Irv_TrqLim /end REF_MEASUREMENT /end GROUP
/end MODULE
/end PROJECT
/* (add any file trailer comments here) */
/* EOF TrqArb.a2l*/
